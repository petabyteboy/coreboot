## src/mainboard/lenovo/x230/Kconfig.name
```kconfig
config BOARD_LENOVO_X230
	bool "ThinkPad X230"

config BOARD_LENOVO_X230T
	bool "ThinkPad X230t"

config BOARD_LENOVO_X230_FHD
	bool "ThinkPad X230 Nitrocaster Full HD mod"
```
